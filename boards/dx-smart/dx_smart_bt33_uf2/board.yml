## boards/dx-smart/dx_smart_bt33_uf2/board.yml
```yaml
# Copyright (c) 2024 Nordic Semiconductor ASA
# SPDX-License-Identifier: Apache-2.0

board:
  name: dx_smart_bt33_uf2
  vendor: dx-smart
  socs:
    - name: nrf52833
```

## boards/etee/etee_dongle_uf2/board.yml
```yaml
# Copyright (c) 2024 Nordic Semiconductor ASA
# SPDX-License-Identifier: Apache-2.0

board:
  name: etee_dongle_uf2
  full_name: eteeDongle
  vendor: etee
  socs:
    - name: nrf52840
```

## boards/foxapplication/foxdongle33_uf2/board.yml
```yaml
# Copyright (c) 2024 Nordic Semiconductor ASA
# SPDX-License-Identifier: Apache-2.0

board:
  name: foxdongle33_uf2
  full_name: foxdongle33_uf2
  vendor: foxapplication
  socs:
    - name: nrf52833
```

## boards/foxapplication/foxdongle_uf2/board.yml
```yaml
# Copyright (c) 2024 Nordic Semiconductor ASA
# SPDX-License-Identifier: Apache-2.0

board:
  name: foxdongle_uf2
  full_name: foxdongle_uf2
  vendor: foxapplication
  socs:
    - name: nrf52840
```

## boards/foxapplication/foxdongle_uf2/foxdongle_uf2_defconfig
```kconfig
# Copyright (c) 2024 Nordic Semiconductor ASA
# SPDX-License-Identifier: Apache-2.0

CONFIG_ARM_MPU=y
CONFIG_HW_STACK_PROTECTION=y
CONFIG_GPIO=y

CONFIG_USB_DEVICE_MANUFACTURER="FoxApplication"
CONFIG_USB_DEVICE_PRODUCT="FoxApplication FoxDongle"

CONFIG_LED_RGB_COLOR=y

CONFIG_USE_SEGGER_RTT=y
CONFIG_RTT_CONSOLE=y
CONFIG_LOG_BACKEND_RTT=y

CONFIG_MPSL=y
CONFIG_MPSL_FEM=y
CONFIG_MPSL_FEM_SIMPLE_GPIO=y
CONFIG_MPSL_FEM_GENERIC_TWO_CTRL_PINS_SUPPORT=y

#generate for adafruit uf2 bootloader flashing
CONFIG_BUILD_OUTPUT_UF2=y
CONFIG_FLASH_LOAD_OFFSET=0x1000
```

## boards/foxapplication/foxpromicro_rfek_uf2/Kconfig.foxpromicro_rfek_uf2
```kconfig
# Copyright (c) 2024 Nordic Semiconductor ASA
# SPDX-License-Identifier: Apache-2.0

config BOARD_FOXPROMICRO_RFEK_UF2
	select SOC_NRF52840_QIAA

if BOARD_FOXPROMICRO_RFEK_UF2

config BOARD_SERIAL_BACKEND_CDC_ACM
	bool "USB CDC"
	default y

config MPSL_FEM_GENERIC_TWO_CTRL_PINS_SUPPORT
    bool "Use FEM"
    default y
    help
        Use RF front-end module (FEM) is a device that amplifies the RF signal, to increase the range distance, the strength, and the robustness of a link connection.

config BOARD_ENABLE_FEM
    bool "FEM enabled"
    default y
    select MPSL_FEM_GENERIC_TWO_CTRL_PINS_SUPPORT
    help
      Enabke front-end module (FEM).

config CONFIG_MPSL
    bool "Enable MPSL"
    default true
    help
      Enable Nordic Multi Protocol Service Layer

config MPSL_FEM_GENERIC_TWO_CTRL_PINS_SUPPORT
    bool
    default y


endif # BOARD_FOXPROMICRO_RFEK_UF2
```

## boards/foxapplication/foxpromicro_rfek_uf2/board.yml
```yaml
# Copyright (c) 2024 Nordic Semiconductor ASA
# SPDX-License-Identifier: Apache-2.0

board:
  name: foxpromicro_rfek_uf2
  full_name: foxpromicro_rfek_uf2
  vendor: foxapplication
  socs:
    - name: nrf52840
```

## boards/holyiot/holyiot_21017/Kconfig.holyiot_21017
```kconfig
# Copyright (c) 2018 Nordic Semiconductor ASA
# SPDX-License-Identifier: Apache-2.0

config BOARD_HOLYIOT_21017
	select SOC_NRF52840_QIAA

if BOARD_HOLYIOT_21017

config BOARD_HAS_NRF5_BOOTLOADER
	bool "Board has nRF5 bootloader"
	default y
	help
	  If selected, applications are linked so that they can be loaded by Nordic
	  nRF5 bootloader.

config BOARD_SERIAL_BACKEND_CDC_ACM
	bool "USB CDC"
	default y

config MPSL_FEM_GENERIC_TWO_CTRL_PINS_SUPPORT
    bool "Use FEM"
    default y
    help
        Use RF front-end module (FEM) is a device that amplifies the RF signal, to increase the range distance, the strength, and the robustness of a link connection.

config BOARD_ENABLE_FEM
    bool "FEM enabled"
    default y
    select MPSL_FEM_GENERIC_TWO_CTRL_PINS_SUPPORT
    help
      Enabke front-end module (FEM).

config CONFIG_MPSL
    bool "Enable MPSL"
    default true
    help
      Enable Nordic Multi Protocol Service Layer

config BOARD_ENABLE_DCDC
    bool "DCDC mode"
    select SOC_DCDC_NRF52X
    default n
    
config MPSL_FEM_GENERIC_TWO_CTRL_PINS_SUPPORT
    bool
    default y

endif # BOARD_HOLYIOT_21017
```

## boards/holyiot/holyiot_21017/board.yml
```yaml
# Copyright (c) 2024 Nordic Semiconductor ASA
# SPDX-License-Identifier: Apache-2.0

board:
  name: holyiot_21017
  full_name: holyiot_21017
  vendor: holyiot
  socs:
  - name: nrf52840
```

## boards/holyiot/holyiot_21017/holyiot_21017_defconfig
```kconfig
# Copyright (c) 2024 Nordic Semiconductor ASA
# SPDX-License-Identifier: Apache-2.0

CONFIG_ARM_MPU=y
CONFIG_HW_STACK_PROTECTION=y
CONFIG_GPIO=y
CONFIG_USB_DEVICE_REMOTE_WAKEUP=n

CONFIG_USB_DEVICE_MANUFACTURER="Holyiot"
CONFIG_USB_DEVICE_PRODUCT="SlimeNRF Receiver Holyiot"

CONFIG_LED_RGB_COLOR=y

CONFIG_USE_SEGGER_RTT=y
CONFIG_RTT_CONSOLE=y
CONFIG_LOG_BACKEND_RTT=y

CONFIG_MPSL=y
CONFIG_MPSL_FEM=y
CONFIG_MPSL_FEM_SIMPLE_GPIO=y
```

## boards/kounolab/kounolab_dongle_uf2/board.yml
```yaml
# Copyright (c) 2024 Nordic Semiconductor ASA
# SPDX-License-Identifier: Apache-2.0

board:
  name: kounolab_dongle_uf2
  full_name: Stella
  vendor: kounolab
  socs:
    - name: nrf52820
```

## boards/kounolab/kounolab_dongle_uf2/kounolab_dongle_uf2_defconfig
```kconfig
# Copyright (c) 2024 Nordic Semiconductor ASA
# SPDX-License-Identifier: Apache-2.0

CONFIG_ARM_MPU=y
CONFIG_HW_STACK_PROTECTION=y

CONFIG_USB_DEVICE_MANUFACTURER="KOUNOLAB"
CONFIG_USB_DEVICE_PRODUCT="SlimeNRF Receiver Stella"

#generate for adafruit uf2 bootloader flashing
#CONFIG_BUILD_OUTPUT_UF2=y
#CONFIG_FLASH_LOAD_OFFSET=0x1000

#enable SPI FEM
CONFIG_MPSL_FEM_NRF21540_GPIO_SPI=y
```

## boards/nekovr/nekovr_dongle_v2/Kconfig.nekovr_dongle_v2
```kconfig
# Copyright (c) 2024 Nordic Semiconductor ASA
# SPDX-License-Identifier: Apache-2.0

config BOARD_NEKOVR_DONGLE_V2
	select SOC_NRF52840_QIAA
```

## boards/nekovr/nekovr_dongle_v2/nekovr_dongle_v2_defconfig
```kconfig
# Copyright (c) 2024 Nordic Semiconductor ASA
# SPDX-License-Identifier: Apache-2.0

CONFIG_ARM_MPU=y
CONFIG_HW_STACK_PROTECTION=y

CONFIG_USB_DEVICE_MANUFACTURER="NekoVR"
CONFIG_USB_DEVICE_PRODUCT="SlimeNRF Receiver NekoVR Dongle"

CONFIG_LED_RGB_COLOR=n
```

## boards/nordic/promicro_uf2/board.yml
```yaml
# Copyright (c) 2024 Nordic Semiconductor ASA
# SPDX-License-Identifier: Apache-2.0

board:
  name: promicro_uf2
  full_name: Pro Micro
  vendor: nordic
  socs:
    - name: nrf52840
```

## boards/slimevr/butterfly_p1/Kconfig.butterfly_p1_uf2
```kconfig
# Copyright (c) 2024 Nordic Semiconductor ASA
# SPDX-License-Identifier: Apache-2.0

config BOARD_BUTTERFLY_P1_UF2
	select SOC_NRF52833_QIAA
```

## boards/slimevr/butterfly_p1/board.yml
```yaml
# Copyright (c) 2024 Nordic Semiconductor ASA
# SPDX-License-Identifier: Apache-2.0

board:
  name: butterfly_p1_uf2
  full_name: Butterfly Receiver P1
  vendor: slimevr
  socs:
    - name: nrf52833
```

## boards/slimevr/butterfly_p2/board.yml
```yaml
# Copyright (c) 2024 Nordic Semiconductor ASA
# SPDX-License-Identifier: Apache-2.0

board:
  name: butterfly_p2_uf2
  full_name: Butterfly Receiver P2
  vendor: slimevr
  socs:
    - name: nrf52833
```

## boards/slimevr/butterfly_p3/Kconfig.butterfly_p3
```kconfig
# Copyright (c) 2024 Nordic Semiconductor ASA
# SPDX-License-Identifier: Apache-2.0

config BOARD_BUTTERFLY_P3
	select SOC_NRF52820_QDAA
```

## boards/slimevr/butterfly_p3/board.yml
```yaml
# Copyright (c) 2024 Nordic Semiconductor ASA
# SPDX-License-Identifier: Apache-2.0

board:
  name: butterfly_p3
  full_name: Butterfly Receiver P3
  vendor: slimevr
  socs:
    - name: nrf52820
```
