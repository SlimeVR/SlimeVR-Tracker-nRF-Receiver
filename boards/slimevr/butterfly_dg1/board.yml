## boards/slimevr/butterfly_dg1/board.yml
```yaml
# Copyright (c) 2024 Nordic Semiconductor ASA
# SPDX-License-Identifier: Apache-2.0

board:
  name: butterfly_dg1
  vendor: slimevr
  socs:
    - name: nrf52833
```
